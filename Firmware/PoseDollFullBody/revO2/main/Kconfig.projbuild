## Firmware/PoseDollFullBody/revO2/main/Kconfig.projbuild
```kconfig
menu "PoseDoll Rev O"
config PD_EXTERNAL_GATEWAY
    bool "External G0 gateway (no sensors)"
    default y
config PD_NODE_ID
    int "Remote measurement node N1..N6 (ignored on G0)"
    range 1 6
    default 1
endmenu
```

## Firmware/PoseDollFullBody/revO5/main/Kconfig.projbuild
```kconfig
menu "PoseDoll Rev O"
config PD_EXTERNAL_GATEWAY
    bool "External G0 gateway (no sensors)"
    default y
config PD_NODE_ID
    int "Remote measurement node N1..N6 (ignored on G0)"
    range 1 6
    default 1
config PD_BENCH_PORTS
    int "Number of physically wired A ports (0..9; clamped to region size)"
    range 0 9
    default 9
endmenu
```

## Hardware/PoseDoll44/bench/revO16/firmware_source/main/Kconfig.projbuild
```kconfig
menu "PoseDoll O15 experimental central acquisition"
config P15_GATEWAY
    bool "External USB G0 (otherwise body central controller)"
    default y
config P15_PEER_MAC
    string "Opposite device MAC, e.g. AA:BB:CC:DD:EE:FF; zero disables radio pairing"
    default "00:00:00:00:00:00"
config P15_CHANNEL
    int "Fixed ESP-NOW Wi-Fi channel"
    range 1 11
    default 1
endmenu
```
